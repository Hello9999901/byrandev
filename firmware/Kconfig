## firmware/Kconfig
```kconfig
config BOARD_ENABLE_DCDC
	bool "Enable DCDC mode"
	select SOC_DCDC_NRF52X
	default y
	depends on (BOARD_BYRANDEV)

choice BOARD_BYRANDEV_CHARGER_CURRENT
    prompt "Charge current to supply to attached batteries"
	depends on (BOARD_BYRANDEV)

config BOARD_BYRANDEV_CHARGER_CURRENT_40MA
    bool "40mA charge current, for battery capacity 40mAh or higher"

config BOARD_BYRANDEV_CHARGER_CURRENT_100MA
    bool "100mA charge current, for battery capacity 100mAh or higher"

config BOARD_BYRANDEV_CHARGER_CURRENT_150MA
    bool "150mA charge current, for battery capacity 150mAh or higher"

config BOARD_BYRANDEV_CHARGER_CURRENT_250MA
    bool "250mA charge current, for battery capacity 250mAh or higher"

config BOARD_BYRANDEV_CHARGER_CURRENT_350MA
    bool "350mA charge current, for battery capacity 350mAh or higher"

config BOARD_BYRANDEV_CHARGER_CURRENT_NONE
    bool "Disable charge current"

endchoice
```

## firmware/Kconfig.board
```kconfig
# byrandev board configuration

# Copyright (c) 2020 The ZMK Contributors
# SPDX-License-Identifier: MIT

config BOARD_BYRANDEV
	bool "byrandev"
	depends on SOC_NRF52840_QIAA
```
